//-----------------------------------------------------------------
//	名称: 乙机程序接收甲机发送的字符并完成相应动作
//-----------------------------------------------------------------
//	说明: 乙机接收到甲机发送的信号后,根据相应信号控制完成不同的
//			LED点亮动作.
//-----------------------------------------------------------------
#include <reg51.h>
#include <intrins.h>
#define INT8U	unsigned char
#define INT16U unsigned int
sbit LED1 = P1^0;
sbit LED2 = P1^3;
sbit K1 = P1^7;
INT8U NumX = 0xFF;
//-----------------------------------------------------------------
// 延时函数	 
//-----------------------------------------------------------------
void delay_ms(INT16U x) {INT8U t; while(x--) for(t = 0; t<120; t++);}
//-----------------------------------------------------------------
// 主程序 
//-----------------------------------------------------------------
void main()
{
	LED1 = LED2 = 1;		//关闭LED
	SCON = 0x50;			//串口模式1，8位异步，允许接收
	TMOD = 0x20;			//T1工作在模式2，8位自动装载
	TH1 = 0xFD;				//设置波特率9600 b/s
	TL1 = 0xFD;
	PCON = 0x00;			//波特率不倍增
	TI = RI = 0;			//发送与接收中断标志位软件清零
	TR1 = 1;				//启动定时器T1
	IE = 0x90;				//允许串口中断
	while(1)
	{
		if (K1 == 0)
		{
			delay_ms(10);
			if (K1 == 0)
				while(K1 == 0);
			else
				continue;
			if (++NumX == 11)		//NumX=0~10，10表示关闭
				NumX = 0;
			SBUF = NumX;			//串口发送
			while(TI == 0);			//等待发送结束
			TI = 0;					//清除接收中断标志位
		}
	}
}

//-----------------------------------------------------------------
// 乙机串口接收中断函数 
//-----------------------------------------------------------------
void Serial_INT() interrupt 4 
{
	if (RI)						        //如果接收到命令字符则完成不同的LED点亮动作
	{
		RI = 0;							//软件清除接收中断标志位
		switch (SBUF)
		{
			case 'X':
				LED1 = 1; LED2 = 1;		//全灭
				break;
			case 'A':
				LED1 = 0; LED2 = 1;		//LED1点亮
				break;
			case 'B':
				LED1 = 1; LED2 = 0;		//LED2点亮
				break;
			case 'C':
				LED1 = 0; LED2 = 0;		//全亮
		}
	}
}