//-----------------------------------------------------------------
//  名称: 甲机串口程序
//-----------------------------------------------------------------
//  说明: 甲单片机向乙单片机发送控制命令字符,甲机同时还可接收乙机
//		发送的数字,所接收的数字显示在数码管上.
//
//-----------------------------------------------------------------
#include <reg51.h>
#include <intrins.h>
#define INT8U  unsigned char
#define INT16U unsigned int
sbit LED1 = P1^0;
sbit LED2 = P1^3;
sbit K1 = P1^7;
INT8U Operation_NO = 0;			//操作代码
const INT8U SEG_CODE[]=			//共阳数码管段码
{ 0xC0,0xF9,0xA4,0xB0,0x99,0x92,0x82,0xF8,0x80,0x90 };
//-----------------------------------------------------------------
// 延时函数	
//-----------------------------------------------------------------
void delay_ms(INT16U x) {INT8U t; while(x--) for(t = 0; t<120; t++);}
//-----------------------------------------------------------------
// 向串口发送字符
//-----------------------------------------------------------------
void putc_to_SerialPort(INT8U c)
{
	SBUF = c;
	while(TI == 0);
	TI = 0;
}

//-----------------------------------------------------------------
// 主程序 
//-----------------------------------------------------------------
void main()
{  
	LED1 = LED2 = 1;	//初始时关闭LED
	P0 = 0xBF;	  		//初始时共阳数码管显示“-”
	SCON = 0x50;		//串口工作在方式1（0101 0000），允许接收
	TMOD = 0x20;		//T1工作在模式2，8位自动装载
	PCON = 0x00;		//波特率不倍增
	TH1 = 0xFD;			//设置波特率9600b/s
	TL1 = 0xFD;			
	TI = RI = 0;		//发送与接收中断标志位软件清零
	TR1 = 1;			//启动定时器T1
	ES = 1;				//允许串口中断
	EA = 1;				//开总中断
	while(1)
	{		  
		//按下K1时选择操作代码：0,1,2,3
		if (K1 == 0)
		{
			delay_ms(10);
			if (K1 == 0)
				while(K1 == 0);
			else
				continue;
			if (++Operation_NO == 4)
				Operation_NO = 0;
			//根据操作代码发送 X/A/B/C
			switch(Operation_NO)
			{
				case 0:
					putc_to_SerialPort('X');
					LED1 = 1;
					LED2 = 1;
					break;
				case 1:
					putc_to_SerialPort('A');
					LED1 = 0;
					LED2 = 1;
					break;
				case 2:
					putc_to_SerialPort('B');
					LED1 = 1;
					LED2 = 0;
					break;
				case 3:
					putc_to_SerialPort('C');
					LED1 = 0;
					LED2 = 0;
					break;
			}
		}
	}
}

//-----------------------------------------------------------------
// 甲机串口接收中断函数 
//-----------------------------------------------------------------
void Serial_INT() interrupt 4 
{
	if (RI)		   //接收到1字节
	{
		RI = 0;	   //清除串行接收中断标志位
		if (SBUF >= 0 && SBUF <= 9)
			P0 = SEG_CODE[SBUF];		   //显示数字
		else
			P0 = 0xFF;
	}
}