//-----------------------------------------------------------------
//  名称: 八只LED双向来回点亮 
//-----------------------------------------------------------------
//  说明：程序利用循环移位函数_crol_和_cror_形成LED来回滚动显示效果
//
//-----------------------------------------------------------------
#include <reg51.h>
#include <intrins.h>
#define INT8U  unsigned char
#define INT16U unsigned int
//-----------------------------------------------------------------
// 延时
//-----------------------------------------------------------------
void delsy_ms(INT16U x)
{
    INT8U t;
    while(x--)
        for(t=0;t<120;t++);
}
//-----------------------------------------------------------------
// 主程序
//-----------------------------------------------------------------
void main()
{
    INT8U i;
    P2 = 0x01;
    delsy_ms(150);
    while(1)
    {
         for(i=0;i<7;i++)
        {
            P2 = _crol_(P2,1);
            delsy_ms(60);
        }
        for(i=0;i<7;i++)
        {
            P2 = _cror_(P2,1);
            delsy_ms(200);
        }
    }
}
