//-----------------------------------------------------------------
//  名称: TIMER0控制8×8LED点阵屏显示数字
//-----------------------------------------------------------------
//  说明: 8×8LED点阵屏循环显示数字0-9,刷新过程由T0定时器溢出中断完成.
//   
//-----------------------------------------------------------------
#include <reg51.h>
#include <intrins.h>
#define INT8U   unsigned char
#define INT16U  unsigned int
//-----------------------------------------------------------------
// 数字点阵
//-----------------------------------------------------------------
INT8U code DotMatrix[] = 
{	0x00,0x3E,0x41,0x41,0x41,0x3E,0x00,0x00,	//0
	0x00,0x00,0x00,0x21,0x7F,0x01,0x00,0x00,	//1
	0x00,0x27,0x45,0x45,0x45,0x39,0x00,0x00,	//2
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	0x00,0x32,0x49,0x49,0x49,0x3E,0x00,0x00		//9
};
//------------------------------------------------------------------
// 主程序
//------------------------------------------------------------------
void main() 
{  
	TMOD = 0x00;					//T0工作于模式0（13位计数）
	TH0 = (8192 - 2000) >> 5;		//设置2ms定时
	TL0 = (8192 - 2000) & 0x1F;
	TR0 = 1; 						//启动定时器T0
	IE = 0x82;						//允许T0中断并开总中断
	while(1);
} 

//------------------------------------------------------------------
// T0定时器溢出中断函数控制LED点阵屏刷新显示
//------------------------------------------------------------------
void LED_Screen_Refresh() interrupt 1 
{
	static INT8U i = 0, Num_Idx = 0, t = 0;
	TH0 = (8192 - 2000) >> 5;			//重设2ms定时
	TL0 = (8192 - 2000) & 0x1F;			
	P2 = 0xFF;							//暂时关闭行码
	P3 = 1 << i;						//扫描输出列码（列共阳）
	P2 = ~DotMatrix[Num_Idx * 8 + i];	//输出行码
	if (++i == 8)						//8位循环
		i = 0;
	if (++t == 200)						//每个数字刷新显示一段时间
	{									
		t = 0x00;						
		if(++Num_Idx == 10)			//显示下一个数字
			Num_Idx = 0;
	}
}