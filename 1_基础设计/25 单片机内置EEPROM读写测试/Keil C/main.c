//-----------------------------------------------------------------
//  名称: 单片机内置EEPROM读写测试
//-----------------------------------------------------------------
//  说明: 按下K1向EEPROM 0x0000地址开始写入512个有序字节, 
//        按下K2时向0x0200地址开始写入512个随机字节
//        按下K3时读取EEPROM中的前512个有序字节并送串口输出显示
//        按下K4时读取EEPROM中的后512个随机字节并送串口输出显示
//  
//-----------------------------------------------------------------
#include "89c51rd2.h"
#include <intrins.h>
#include <absacc.h>
#include <math.h>
#include <stdlib.h>
#define INT8U	unsigned char
#define INT16U	unsigned int
sbit LED_WR = P0^0;				//写入指示灯
sbit K1 = P1^1;					//K1按键
sbit K2 = P1^3;					//K2按键
sbit K3 = P1^5;					//K3按键
sbit K4 = P1^7;					//K4按键
INT8U OP = 0xFF;
//-----------------------------------------------------------------
// 延时
//-----------------------------------------------------------------
void delay_ms(INT16U x) {INT8U t; while(x--) for(t = 0; t<120; t++);}
//-----------------------------------------------------------------
// 从指定的内置EEPROM地址读取1字节
//-----------------------------------------------------------------
INT8U ReadEEPROM (INT16U addr)
{
	INT8U dat;
	EECON = 0x02;			//使能EEPROM映射(EEE)
	dat = XBYTE[addr];		//读取1字节
	EECON = 0x00;			//禁止EEPROM映射
	return  dat;
}

//-----------------------------------------------------------------
// 向内置EEPROM指定地址写入1字节
//-----------------------------------------------------------------
void WriteEEPROM (INT16U addr, INT8U dat)
{
	while (EECON == 0xA3);	//EEPOM忙等待(EEBUSY)
	EECON = 0x02;			//使能EEPROM映射(EEE)
	EETIM = 0xC8;			//设置EETIM为5xFxtal
	XBYTE[addr] = dat;		//写入1字节
	EECON = 0x52;			//输出EEPROM写时序:52H A2H
	EECON = 0xA2;
	while (EECON == 0xA3);	//EEPOM忙等待(EEBUSY)
	EECON = 0x00;			//禁止EEPROM映射
}

//-----------------------------------------------------------------
// 向串口输出一个字符
//-----------------------------------------------------------------
void PutChar(INT8U c)	{	SBUF = c; while (TI == 0); TI = 0;	}
//------------------------------------------------------------------
// 串口输出字符串
//------------------------------------------------------------------
void Putstr(char *s)	{	while (*s) PutChar(*s++);	}
//-----------------------------------------------------------------
// 以十六进制形式显示所读取的字节
//-----------------------------------------------------------------
void Puts_HEX(INT8U dat)
{
	char s[] = "   ";		//字符串初始为三个空格
	//将dat转换为字符串s
	s[0] = dat >> 4;
	s[1] = dat && 0x0F;
	if (s[0] <= 9)
		s[0] += '0';
	else
		s[0] += 'A' - 10;
	if (s[1] <= 9)
		s[1] += '0';
	else
		s[1] += 'A' - 10;
	Putstr(s);
}

//-----------------------------------------------------------------
// 串口配置
//-----------------------------------------------------------------
void Init_USART()
{
	SCON = 0x50;	 	//串口工作在方式1
	TMOD = 0x20;		//T1工作在模式2，8位自动装载
	PCON = 0x00;		//波特率不倍增
	TH1	= TL1 = 0xFD;	//波特率 9600 b/s （@ 11.0592 MHz）
	TR1 = 1;			//启动定时器T1
}

//-----------------------------------------------------------------
// 主程序
//-----------------------------------------------------------------
void main()
{
	INT16U i;
	LED_WR = 1;						//初始时写入指示关闭
	Init_USART(); delay_ms(100); 	//USART初始化
	//提示进行K1-K4操作
	Putstr("Plase Press K1,K2,K3 or K4 to Play EEPROM Test...\r\n");
	srand(300);						//设置随机种子
	while(1)
	{	while (P1 == 0xFF); //未按键则等待-------------------------
		if		(K1 == 0) { delay_ms(10); if (K1 == 0) OP = 1; }
		else if (K2 == 0) { delay_ms(10); if (K2 == 0) OP = 2; }
		else if (K3 == 0) { delay_ms(10); if (K3 == 0) OP = 3; }
		else if (K4 == 0) { delay_ms(10); if (K4 == 0) OP = 4; }
		if (OP == 1) 	  //--------------------------------------------
		{	
			Putstr("Write EEPROM order bytes(512)...\r\n"); 
			LED_WR = 0;
			for (i=0; i<512; i++)	//从0x0000地址开始写入512个有序字节
				WriteEEPROM(0x0000 + i, i);
			LED_WR = 1;			
		}
		else if (OP == 2) //---------------------------------------
		{	
			Putstr("Write EEPROM random bytes(512)...\r\n"); 
			LED_WR = 0;
			for (i=0; i<512; i++)	//从0x0200地址开始写入512个随机字节
				WriteEEPROM(0x0200 + i, rand());
			LED_WR = 1;					   
		}
		else if (OP == 3) //---------------------------------------
		{	
			Putstr("\r\r\rRead EEPROM DEMO: orderd bytes......\r\n");
			//从0x0000地址读取512个有序字节并显示
			for (i=0; i<512; i++)
			{
				//读取并显示1字节
				Puts_HEX(ReadEEPROM(0x0000 + i));
				if ((i+1) % 30 == 0)
					Putstr("\r\n");
			}								  
		}
		else if (OP == 4) //---------------------------------------
		{	
			Putstr("\r\r\rRead EEPROM DEMO: random bytes......\r\n");
			//从0x0200地址读取512个随机字节并显示
			for (i=0; i<512; i++)
			{
				//读取并显示1字节
				Puts_HEX(ReadEEPROM(0x0200 + i));
				if ((i+1) % 30 == 0)
					Putstr("\r\n");
			}
		}
		Putstr("\r\n----OK!!!-----\r\n");
		while (P1 != 0xFF); 		//等待释放按键-----------------
	}
}