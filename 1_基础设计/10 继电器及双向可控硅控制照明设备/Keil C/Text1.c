//-----------------------------------------------------------------
//  名称: 继电器及双向可控硅控制照明设备
//-----------------------------------------------------------------
//  说明: K1/K2分别控制继电器与可控硅开关.
//-----------------------------------------------------------------
#include <reg51.h>
#define INT8U  unsigned char
#define INT16U unsigned int
sbit  K1 = P0^0;		//继电器控制按键(注意接上拉电阻)
sbit  K2 = P1^7;		//双向可控硅控制按键
sbit  RELAY = P2^0;		//继电器控制引脚
sbit  TRIAC = P2^1;		//双向可控硅控制引脚
//-----------------------------------------------------------------
// 延时子程序	  
//-----------------------------------------------------------------
void delay_ms(INT16U x) 
{
	INT8U t; while(x--) for(t = 0; t < 120; t++);
}

//-----------------------------------------------------------------
// 主程序
//-----------------------------------------------------------------
void main()
{
	RELAY = 1 ;  TRIAC = 1;		//初始时两个灯泡都关闭；
	while(1)
	{
		if( K1 == 0)
		{
			delay_ms(10);
			if( K1 == 0)
			{
				while(K1 == 0);
				RELAY = ~RELAY;
			}	
		}
		if( K2 == 0)		  	//可控硅开关控制；
		{
			delay_ms(10);
			if( K2 == 0)
			{
				while(K2 == 0);
				TRIAC = ~TRIAC;
			}	
		}
	}
}