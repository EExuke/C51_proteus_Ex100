//-----------------------------------------------------------------
//  名称: 普通开关与拨码开关应用
//-----------------------------------------------------------------
//  说明: SW1控制显示开/关,拨码开关所设置的编码000-255(0x00-0xFF)由
//		  数码管显示,显示开关控制使用了8总线收发驱动器74LS245控制及
//		  位码控制两种方法.
//		  SW2控制报警器,实现两种不同频率的声音输出.
//-----------------------------------------------------------------
#include <reg51.h>
#include <intrins.h>
#define INT8U  unsigned char
#define INT16U unsigned int
//数码管段码
code INT8U SEG_CODE[] = {0x3F,0x06,0x5B,0x4F,0x66,0x6D,0x7D,0x07,0x7F,0x6F};
INT8U disp_buff[3] = {0,0,0};	//显示缓冲
sbit BUZZER = P3^3;				//蜂鸣器定义
sbit SW1	= P3^0;				//显示开关
sbit SW2	= P3^6;				//报警器开关
sbit CE		= P2^0;				//74LS245使能控制端
//-----------------------------------------------------------------
// 延时函数
//-----------------------------------------------------------------
void delay_ms(INT16U x)
{
	INT8U t; while(x--) for(t = 0; t < 120; t++);
}				 
//-----------------------------------------------------------------
// 报警声音子程序
//-----------------------------------------------------------------
void Alarm(INT8U t)
{
	INT8U i,j;
	for(i=0;i<150;i++)
	{
		BUZZER = ~BUZZER;		//蜂鸣器输出；
		for(j=0;j<t;j++);		//参数t形成不同的延时，输出不同的频率；	
	}
}
//-----------------------------------------------------------------
// 主程序
//-----------------------------------------------------------------
void main()
{
	INT8U i;					//循环控制变量；
	CE = 0;						//初始时使能74LS245；
	while(1)
	{
		if(SW1)					//未合上sw1关闭显示；
		{
			CE = 1;				//禁止74LS245（关显示）；
			//P2 = 0xFF;		//或者用关闭位码来关闭显示；
		}
		else
		{
			CE = 0;				//使能74LS245；
			/*由P1口读取的拨码开关值分解数位*/
			disp_buff[0] = P1 /100;			//百位；
			disp_buff[1] = P1 /10 % 10;		//十位；
			disp_buff[2] = P1 % 10;			//个位；
			/*刷新显示在数码管上*/
			for(i=0;i<3;i++)
			{
				P0 = 0x00;						//暂时关闭段码；
				P2 = (~(0x20 << i)) & 0xF0 ;	//发送位码；
				P0 = SEG_CODE[ disp_buff[i] ];  //发送段码；
				delay_ms(4);
			}
		}
		if(SW2)		   		//报警控制输出；
		{
			Alarm(90) ;
			Alarm(120);
		}
	}
}