//-----------------------------------------------------------------
//	名称: 数码管显示4×4 键盘矩阵按键序号
//-----------------------------------------------------------------
//	说明: 按下任意一按键时,数码管会显示它在键盘矩阵上的序号0 - F,
//		扫描程序首先判断按键发生在哪一列,然后根据所发生的行附加
//		不同的值,从而得到键盘按键序号.			
//-----------------------------------------------------------------
#include <reg51.h>
#define INT8U	unsigned char
#define INT16U unsigned int
//0~F的共阳数码管段码,最后一个是黑屏
const INT8U SEG_CODE[] =
{ 0xC0,0xF9,0xA4,0xB0,0x99,0x92,0x82,0xF8,
  0x80,0x90,0x88,0x83,0xC6,0xA1,0x86,0x8E,0xFF
};

sbit BEEP = P3^0; 	 
//上次按键和当前按键序号,该矩阵中序号范围为0-15,0xFF表示无按键
INT8U pre_keyNo = 0xFF, keyNo = 0xFF;
//-----------------------------------------------------------------
// 延时函数
//-----------------------------------------------------------------
void delay_ms(INT16U x)
{
	INT8U t; while(x--) for(t = 0; t < 120; t++);
}
//-----------------------------------------------------------------
// 键盘矩阵扫描子程序
//-----------------------------------------------------------------
void Keys_Scan()
{ 
	//高四位置0，放入四行，扫描四列；
	P1 = 0x0F;	delay_ms(1);
	if(P1 == 0x0f) {keyNo = 0xFF; return;}
	//按键后00001111将变成0000xxxx；
	//下面判断0~3中哪一列；
	switch(P1)
	{
		case 0x0E: keyNo = 0;	break;	//按键在第0列；
		case 0x0D: keyNo = 1;	break;	//按键在第1列；
		case 0x0B: keyNo = 2;	break;	//按键在第2列；
		case 0x07: keyNo = 3;	break;	//按键在第3列；
		default:   keyNo = 0xFF; return;  //无按键按下；
	}
	//低四位置0，放入四列，扫描四行；
	P1 = 0xF0;	delay_ms(1);
	if(P1 == 0x0f) {keyNo = 0xFF; return;}
	//按键后11110000将变成xxxx0000；
	//下面判断0~3中哪一行；对每行附加的起始值为0，4，8，12；
	switch(P1)
	{
		case 0xE0: keyNo += 0;	break;	//按键在第0行；
		case 0xD0: keyNo += 4;	break;	//按键在第1行；
		case 0xB0: keyNo += 8;	break;	//按键在第2行；
		case 0x70: keyNo += 12;	break;	//按键在第3行；
		default:   keyNo = 0xFF;   //无按键按下；
	}	
}
//-----------------------------------------------------------------
// 蜂鸣器子程序
//-----------------------------------------------------------------
void Beep()
{
	INT8U i;
	for(i=0;i<100;i++)
	{
		delay_ms(1);
		BEEP = ~BEEP;	
	}
	BEEP = 1;	
}
//-----------------------------------------------------------------
// 主程序
//-----------------------------------------------------------------
void main()
{
	P0 = 0xFF;	  //初始化共阳管黑屏；
	while(1)
	{
		Keys_Scan();		//扫描键盘获取键值；
		if(keyNo == 0xFF) {delay_ms(10);continue;}	//无按键时延时10ms，然后继续扫描；
		P0 = SEG_CODE[keyNo];	//显示键值； 
		Beep();
		while(Keys_Scan(),keyNo != 0xFF);	//未释放时等待；
	}
}