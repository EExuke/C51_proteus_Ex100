//-----------------------------------------------------------------
//  名称: SPI接口存储器AT245F1024读写与显示
//-----------------------------------------------------------------
//  说明: 程序运行时,按下K1~K4所执行的操作如下:
//        K1: 先清除数据,然后在前面写入256个字节(0x00-0xFF)
//            最末尾写入256个随机字节(中间部分不写入)
//        K2: 读取并显示最前面256个字节(有序)
//        K3: 读取并显示最后面256个字节(无序)
//        K4: 读取并显示厂家/设备ID(AT25F1024A: VID/PID=1F60)
//
//-----------------------------------------------------------------
#include <reg52.h>
#include <intrins.h>
#include <stdlib.h>
#define INT8U  unsigned char
#define INT16U unsigned int
#define INT32U unsigned long
//SPI接口存储器引脚定义
sbit CS  = P1^0;				//片选
sbit SO  = P1^1;				//串行数据输出
sbit SI  = P1^2;				//串行数据输入
sbit SCK = P1^3;				//串行时钟控制脚
//SPI接口存储器操作命令定义
#define WREN			0x06	//使能写
#define WRDI			0x04	//禁止写
#define RDSR			0x05	//读状态
#define WRSR			0x01	//写状态
#define READ			0x03	//读字节
#define WRITE			0x02	//写字节
#define SECTOR_ERASE	0x52	//删除区域数据
#define CHIP_ERASE		0x62	//删除芯片数据
#define RDID			0x15	//读厂商与产品ID
//按键定义
#define K1_DOWN() ((P0 & (1<<0)) == 0x00)	//写入两组字节
#define K2_DOWN() ((P0 & (1<<2)) == 0x00)	//读前20字节并显示
#define K3_DOWN() ((P0 & (1<<4)) == 0x00)	//读后20字节并显示
#define K4_DOWN() ((P0 & (1<<6)) == 0x00)	//显示厂家和产品ID
//LED操作定义
#define LED_ON()	P2 &= ~(1<<0)			//LED点亮
#define LED_BLINK()	P2 ^=  (1<<0)			//LED闪烁
//数码管位引脚定义
sbit D0  = P2^6;
sbit D1  = P2^7;
//0~F的数码管段码表(共阴数码管)
code INT8U SEG_CODE[] = 
{ 0x3F,0x06,0x5B,0x4F,0x66,0x6D,0x7D,0x07,
  0x6F,0x77,0x7F,0x7C,0x39,0x5E,0x79,0x71
};
//读写字节数据的临时存放空间及有效数据长度
INT8U  TMP_Buffer[256];
INT16U Buffer_LEN = 256;
INT8U Display_Buffer[] = {0,0};//分解后的待显示数位
//-----------------------------------------------------------------
// 延时函数
//-----------------------------------------------------------------
void delay_ms(INT8U x) {INT8U t; while(x--) for(t = 0; t<120; t++);}
//-----------------------------------------------------------------
// 数码管显示一字节(16进制)
//-----------------------------------------------------------------
void Show_Count_ON_DSY()
{   


}

//-----------------------------------------------------------------
// 从当前地址读取一字节数据
//-----------------------------------------------------------------
INT8U ReadByte()
{


}

//-----------------------------------------------------------------
// 向当前地址写入一字节数据
//-----------------------------------------------------------------
void WriteByte(INT8U dat)
{


}

//-----------------------------------------------------------------
// 读AT25F1024A芯片状态
//-----------------------------------------------------------------
INT8U Read_SPI_Status()
{


}

//-----------------------------------------------------------------
// AT25F1024A忙等待
//-----------------------------------------------------------------
void Busy_Wait(){ while(Read_SPI_Status() & 0x01);}	//忙等待

//-----------------------------------------------------------------
// 删除AT25F1024A芯片未加保护的所有区域数据
//-----------------------------------------------------------------
void ChipErase() 
{



}

//-----------------------------------------------------------------
// 向AT25F1024A写入三个字节的地址0x000000-0x01FFFF 
//-----------------------------------------------------------------
void Write_3_Bytes_SPI_Address(INT32U addr)
{


}

//-----------------------------------------------------------------
// 从指定地址读单字节
//-----------------------------------------------------------------
INT8U Read_Byte_From_AT25F1024A(INT32U addr)
{


}

//-----------------------------------------------------------------
// 从指定地址读多字节到缓冲
//-----------------------------------------------------------------
//void Read_Some_Bytes_From_AT25F1024A(INT32U addr, INT8U *p, INT16U len)
//{
//	INT16U i;
//	CS = 0;									//片选
//	WriteByte(READ);						//发送读指令
//	Write_3_Bytes_SPI_Address(addr);		//发送三字节地址
//	for( i = 0; i < len; i++) p[i] = ReadByte();//读取多字节数据
//	CS = 1;									//禁止片选
//}

//-----------------------------------------------------------------
// 向AT25F1024A指定地址写入单字节数据
//-----------------------------------------------------------------
void Write_Byte_To_AT25F1024A(INT32U addr,INT8U dat)
{	


}

//-----------------------------------------------------------------
// 向AT25F1024A指定地址开始写入多字节数据
//-----------------------------------------------------------------
//void Write_Some_Bytes_To_AT25F1024A(INT32U addr,INT8U *p,INT16U len)
//{	
//	INT16U i;
//	CS = 0;									//片选
//	WriteByte(WREN);						//使能写
//	CS = 1;									//禁止片选
//	Busy_Wait(); 							//忙等待
//	CS = 0;									//片选
//	WriteByte(WRITE);						//写指令
//	Write_3_Bytes_SPI_Address(addr);		//发送三字节地址
//	for (i = 0; i < len; i++) WriteByte(p[i]);//写多字节数据
//	CS = 1;									//禁止片选
//	Busy_Wait();
//}

//-----------------------------------------------------------------
// 读取AT25F1024A的厂商和产品ID
//-----------------------------------------------------------------
void Get_VID_PID()
{ 


}

//-----------------------------------------------------------------
// 主程序
//-----------------------------------------------------------------
void main()
{
	INT32U i;
	INT8U Current_Data,Current_Disp_Index = 0,LOOP_SHOW_FLAG = 0, k;
	while(1)
	{	Begin:
		//K1:向AT25F1024A写入数据
		if(K1_DOWN()) //--------------------------------------------
		{	



		}
		//K2:读取并显示前256个字节
	 	if (K2_DOWN()) //-------------------------------------------
		{	


		}
		//K3:读取并显示后256个字节
		if (K3_DOWN()) //-------------------------------------------
		{


		}
		//K4:显示厂家和设备ID
		if (K4_DOWN()) //-------------------------------------------
		{


		}
		//循环显示数据
		if (LOOP_SHOW_FLAG)  //-------------------------------------
		{



		}
	}
}