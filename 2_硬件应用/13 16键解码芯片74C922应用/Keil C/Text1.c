//-----------------------------------------------------------------
//  名称: 16键解码芯片74C922应用
//-----------------------------------------------------------------
//  说明: 本例因为使用了74C922解码芯片,使得程序代码非常简单
//		  在按下不同按键时,数码管将显示对应键值.
//
//-----------------------------------------------------------------
#include <reg51.h>
#include <intrins.h>
#define INT8U  unsigned char
#define INT16U unsigned int
#define BEEP() P0 ^= (1<<3)		//蜂鸣器(连接在P0.3)
sbit DA = P2^4;					//按键判断(有键按下时DA输出高电平)
#define Key_Pressed (DA == 1)
#define Key_NO (P2 & 0x0F)		//获取键值(P2端口低4位)
//0-9,A-F的数码管段码
code INT8U SEG_CODE[] = 
{ 0x3F,0x06,0x5B,0x4F,0x66,0x6D,0x7D,0x07,
  0x7F,0x6F,0x77,0x7C,0x39,0x5E,0x79,0x71
};
//-----------------------------------------------------------------
// 延时函数
//-----------------------------------------------------------------
void delay_us(INT8U x) 
{
	while(--x) _nop_();
}

//-----------------------------------------------------------------
// 发声子程序	 
//-----------------------------------------------------------------
void Sounder()
{
	INT8U i;
	for (i = 0; i < 10; i++)
	{
		delay_us(50);
		BEEP();
	}
}

//-----------------------------------------------------------------
// 主程序
//-----------------------------------------------------------------
void main()
{
	P1 = 0x00;						//初始时关闭数码管显示
	while(1)
	{
		if (Key_Pressed)			//有按键按下
		{					
			P1 = SEG_CODE[Key_NO];	//根据键值Key_NO显示按键
			Sounder();				//输出提示音
		}
	}
}
