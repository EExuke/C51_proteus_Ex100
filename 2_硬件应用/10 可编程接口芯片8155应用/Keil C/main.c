//-----------------------------------------------------------------
//  名称: 可编程序接口芯片8155应用
//-----------------------------------------------------------------
//  说明: 本例利用8155的PA,PB连接数码管,显示8155当前定时初值,
//		  PC端口连接按键,分别用于调整定时初值,启动定时器,写8155RAM等.
//		  启动定时器后,在定时溢出时,8155 TOUT将触发INT0中断,输出提示音.
//		  所调节的定时初值不同时,声音输出的间隔也不同.
//
//-----------------------------------------------------------------
#include <reg51.h>
#include <intrins.h>
#include <absacc.h>
#define INT8U  unsigned char
#define INT16U unsigned int
//-----------------------------------------------------------------
//8155地址定义
#define COMM_8155		XBYTE[0xFD00]	//命令字端口
#define PA_8155			XBYTE[0xFD01]	//PA端口地址
#define PB_8155			XBYTE[0xFD02]	//PB端口地址
#define PC_8155			XBYTE[0xFD03]	//PC端口地址
#define CONT_8155_L8	XBYTE[0xFD04]	//计数器低8位地址
#define CONT_8155_H8	XBYTE[0xFD05]	//计数器高6位+2位方式地址
#define PMEM_8155		XBYTE[0xFC00]	//8155RAM地址
//-----------------------------------------------------------------
//上述定义也可写成:
//#define COMM_8155		*(XBYTE+0xFD00)	//命令字端口
//#define PA_8155		*(XBYTE+0xFD01)	//PA端口地址
//#define PB_8155		*(XBYTE+0xFD02)	//PB端口地址
//#define PC_8155		*(XBYTE+0xFD03)	//PC端口地址
//#define CONT_8155_L8	*(XBYTE+0xFD04)	//计数器低8位地址
//#define CONT_8155_H8	*(XBYTE+0xFD05)	//计数器高6位+2位方式地址
//#define PMEM_8155		*(XBYTE+0xFC00)	//8155RAM地址
//-----------------------------------------------------------------
#define BEEP() P1 ^= (1<<0)				//蜂鸣器定义
//0-9的共阳数码管段码表,最后一位为黑屏
const INT8U SEG_CODE[] =
{ 0xC0,0xF9,0xA4,0xB0,0x99,0x92,0x82,0xF8,0x80,0x90,0xFF };
INT8U Disp_Buffer[4] = {10,4,0,0};		//待显示信息缓冲
volatile INT16U cnt_8155 = 400;			//8155定时计数初值变量
enum OP_Type {ADD,SUB};					//定时初值递增或递减
//-----------------------------------------------------------------
// 延时函数
//-----------------------------------------------------------------
void delay_ms(INT16U x) 
{
	INT8U t; while(x--) for(t = 0; t < 120; t++);
}

//-----------------------------------------------------------------
// 输出提示音
//-----------------------------------------------------------------
void Sounder()
{
	INT8U i,j;
	for (i = 0; i < 50; i++) { BEEP();j = 100; while (--j); }
}

//-----------------------------------------------------------------
// 设置8155 定时初值
//-----------------------------------------------------------------
void Set_8155_TC()
{
	CONT_8155_L8 = cnt_8155;			//装入定时器初值低字节
	CONT_8155_H8 = cnt_8155 >> 8;		//装入定时器初值高字节
	COMM_8155 = 0xC3;	//0B11000011;	//设置PA,PB,PC端口方式及定时器命令
}

//-----------------------------------------------------------------
// 8155定时初值调整
//-----------------------------------------------------------------
void adjust_tCount(enum OP_Type op)
{
	INT8U i;
	INT16U cnt;
	cnt_8155 = (op == ADD) ? cnt_8155 + 50 : cnt_8155 - 50;
	if (cnt_8155 > 500)
		cnt_8155 = 500;
	else if (cnt_8155 < 100)
		cnt_8155 = 100;
	cnt = cnt_8155;
	for (i = 3; i >= 1; i--)
	{
		Disp_Buffer[i] = cnt % 10;	//从低位开始逐位分解
		cnt /= 10;
	}
}

//-----------------------------------------------------------------
// 8155PC端口按键处理
//-----------------------------------------------------------------
void Key_Process()
{
	INT8U i;
	static INT8U Pre_Key_State = 0xFF;
	INT8U curr_Key_State = PC_8155 | 0xF0;
	if (Pre_Key_State == curr_Key_State)
		return;
	Pre_Key_State = curr_Key_State;
	switch(curr_Key_State)
	{
		case ~(1<<0):	//K1：递增8155定时初值，每次递增50
			adjust_tCount(ADD); break;
		case ~(1<<1):	//K2：递减8155定时初值，每次递减50
			adjust_tCount(SUB); break;
		case ~(1<<2):	//K3：设置并启动8155定时器
			Set_8155_TC();
		case ~(1<<3):	//K4：写8155RAM:0~100
			for(i=0; i<=100; i++)
				*(&PMEM_8155 + i) = i;
			break;		
	}
}

//-----------------------------------------------------------------
// 主程序
//-----------------------------------------------------------------
int main()
{	
	INT8U i;
	IE = 0x81;	//允许INT0中断
	IT0 = 1;	//下降沿触发
	//设置8155命令字：PA、PB输出，PC输入，不影响计数器工作
	COMM_8155 = 0x03;	//0B00000011;
	P1 = 0x00;
	while(1)
	{
		for(i=0; i<4; i++)	//4位数码管显示
		{
			PB_8155 = 0x00;	//暂时关闭
			PA_8155 = SEG_CODE[Disp_Buffer[i]];	//向8155PA端口发送段码
			PB_8155 = 1 << (7 - i);		//向8155PB端口发送位码
			delay_ms(4);	//位间延时
			Key_Process();	//8155PC端口按键处理
		}
	}
}

//-----------------------------------------------------------------
// INT0中断函数
//-----------------------------------------------------------------
void EX_INT0() interrupt 0 
{
	EA = 0;				//关中断
	Sounder();			//蜂鸣器输出
	Set_8155_TC();		//重置8155 TC初值并启动
	EA = 1;				//开中断
}
