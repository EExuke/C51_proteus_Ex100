//-----------------------------------------------------------------
//  名称: 62256扩展内存  
//-----------------------------------------------------------------
//  说明: 本例先向62256地址0x0000写入0x00-0xFF,然后将其逆向拷贝到
//        0x0120地址位置.指示灯闪烁可暂停程序,用debug查看内存.
//
//-----------------------------------------------------------------
#include <reg51.h>
#include <intrins.h>
#include <absacc.h>
#define INT8U  unsigned char
#define INT16U unsigned int
#define LED_ON()	P1 &= ~(1<<0)	 //LED点亮
#define LED_BLINK() P1 ^=  (1<<0)	 //LED闪烁
//-----------------------------------------------------------------
// 延时函数
//-----------------------------------------------------------------
void delay_ms(INT16U x) 
{
	INT8U t; while(x--) for(t = 0; t < 120; t++);
}

//-----------------------------------------------------------------
// 主程序
//-----------------------------------------------------------------
void main() 
{ 
	INT16U i;
	LED_ON();	//初始时LED点亮
	//向62256的0x0000地址开始写入0x00-0xFF
	for(i=0x0000; i<0x00FF; i++)
		XBYTE[i] = (INT8U)i;
	//再将写入的256字节数据逆向赋值到0x0120开始处
	for(i=0x0000; i<0x00FF; i++)
		XBYTE[i+0x0120] = XBYTE[0x00FF - i];
	delay_ms(1000);
	//扩展内存数据处理完成后LED闪烁
	while(1)
	{
		LED_BLINK();
		delay_ms(100);
	}
} 