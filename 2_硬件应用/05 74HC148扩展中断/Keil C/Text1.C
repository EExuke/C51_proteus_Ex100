//-----------------------------------------------------------------
//  名称: 74HC148扩展中断
//-----------------------------------------------------------------
//  说明: 通过74LS148扩展外部中断,对于外部的8个控制开关,任意一个
//		  合上都将在GS引脚输出低电平,触发外部中断,优先级最高的是
//		  输入引脚7,最低的是输入引脚0.中断触发后,中断例程通过读取
//		  A2,A1,A0的输出值,判断是哪一路开关触发了中断.
//					  
//-----------------------------------------------------------------
#include <reg51.h>
#include <intrins.h>
#define INT8U  unsigned char
#define INT16U unsigned int 
sbit LED  = P1^0;					//由主程序控制的LED
//-----------------------------------------------------------------
// 延时函数
//-----------------------------------------------------------------
void delay_ms(INT16U x) 
{
	INT8U t; while(x--) for(t = 0; t < 120; t++);
}

//-----------------------------------------------------------------
// INT0中断程序(当有开关合上时,GS为零,触发中断0)
//-----------------------------------------------------------------
void EX_INTO() interrupt 0 
{		
	P0 = ~(1 << (P2 & 0x07));	//中断控制点亮按键对应的LED
}

//-----------------------------------------------------------------
// 主程序 (Proteus中74HC148存在问题,与输入引脚0对应的开关控制无效)
//-----------------------------------------------------------------
void main() 
{ 
	IE = 0x81;			//外部中断0许可
	IT0 = 0;			//低电平触发中断
	while(1)
	{
		LED = !LED;			//主程序控制一只LED闪烁
		delay_ms(30);
		if (INT0 == 1)		//GS为1
			P0 = 0xFF;		//无按键合上，关闭所有LED
	}
}