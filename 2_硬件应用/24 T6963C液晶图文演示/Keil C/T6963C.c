//-----------------------------------------------------------------
// T6963C液晶显示驱动程序
//-----------------------------------------------------------------
#include <stdarg.h>
#include <stdio.h>
#include <math.h>
#include <intrins.h>
#include <absacc.h>
#include <string.h>
#include <T6963C.h>
//ASCII字模宽度及高度定义
#define ASC_CHR_WIDTH	8
#define ASC_CHR_HEIGHT	12
#define HZ_CHR_HEIGHT	12
#define HZ_CHR_WIDTH	12 
INT8U code LCD_WIDTH  = 20;   //宽160像素(160/8 = 20个字节)
INT8U code LCD_HEIGHT = 128;  //高128像素
INT8U code ASC_MSK[96 * 12] = {
0x00,0x00,0x00,0x00,0x00,0x00,0x00,0xff,0xff,0xff,0xff,0xff, // < 0x20时
0x00,0x00,0x00,0x00,0x00,0x00,0x00,0x00,0x00,0x00,0x00,0x00,// ' '
0x00,0x30,0x78,0x78,0x78,0x30,0x30,0x00,0x30,0x30,0x00,0x00,// '!'
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0x00,0x73,0xda,0xce,0x00,0x00,0x00,0x00,0x00,0x00,0x00,0x00,// '~'
};
INT8U gCurRow,gCurCol;		//图形当前行、列存储，行高16点，列宽8点
INT8U tCurRow,tCurCol;		//文本当前行、列存储，行高8点 ，列宽8点
INT8U ShowModeSW;			//当前显示模式
INT16U  txthome,grhome;
//-----------------------------------------------------------------
// LCD控制相关函数
//-----------------------------------------------------------------
INT8U Status_BIT_01();		//状态位STA1,STA0判断（读写指令和读写数据）
INT8U Status_BIT_3();		//状态位ST3判断（数据自动写状态）
INT8U LCD_Write_Command(INT8U);					//写无参数指令
INT8U LCD_Write_Command_P1(INT8U,INT8U);		//写单参数指令
INT8U LCD_Write_Command_P2(INT8U,INT8U,INT8U);	//写双参数指令
INT8U LCD_Write_Data(INT8U);					//写数据
INT8U LCD_Read_Data();							//读数据
void cls();										//清屏
char LCD_Initialise();							//LCD初始化
void Set_LCD_POS(INT8U row, INT8U col);			//设置当前地址
void OutToLCD(INT8U Dat,INT8U x,INT8U y); 		//显示辅助函数
void Line(INT8U, INT8U, INT8U, INT8U, bit);		//绘制直线
void Pixel(INT8U,INT8U, bit);					//绘点
//-----------------------------------------------------------------
// 状态位STA1,STA0判断(读写指令和读写数据)
//-----------------------------------------------------------------
INT8U Status_BIT_01() 
{

}

//-----------------------------------------------------------------
// 状态位ST3判断(数据自动写状态)
//-----------------------------------------------------------------
INT8U Status_BIT_3() 
{

}

//-----------------------------------------------------------------
// 写双参数指令
//-----------------------------------------------------------------
INT8U LCD_Write_Command_P2(INT8U cmd,INT8U para1,INT8U para2) 
{

}

//-----------------------------------------------------------------
// 写单参数指令
//-----------------------------------------------------------------
INT8U LCD_Write_Command_P1(INT8U cmd,INT8U para1) 
{

}

//-----------------------------------------------------------------
// 写无参数指令
//-----------------------------------------------------------------
INT8U LCD_Write_Command(INT8U cmd) 
{

}

//-----------------------------------------------------------------
// 写数据
//-----------------------------------------------------------------
INT8U LCD_Write_Data(INT8U dat) 
{

}

//-----------------------------------------------------------------
// 读数据
//-----------------------------------------------------------------
INT8U LCD_Read_Data() 
{

}

//-----------------------------------------------------------------
// 设置当前地址
//-----------------------------------------------------------------
void Set_LCD_POS(INT8U row, INT8U col)	
{
	INT16U Pos;	
	Pos = row * LCD_WIDTH + col;
	LCD_Write_Command_P2(LCD_ADD_POS,Pos & 0xFF, Pos>>8);
	gCurRow = row;
	gCurCol = col;
}

//-----------------------------------------------------------------
// 清屏
//-----------------------------------------------------------------
void cls()
{
	INT16U i;
	LCD_Write_Command_P2(LCD_ADD_POS,0x00,0x00);		//置地址指针
	LCD_Write_Command(LCD_AUT_WR);						//自动写
	for(i = 0;i < 0x2000; i++)
	{   Status_BIT_3();
		LCD_Write_Data(0x00);							//写数据
	}
	LCD_Write_Command(LCD_AUT_OVR);						//自动写结束
	LCD_Write_Command_P2(LCD_ADD_POS,0x00,0x00);		//重置地址指针
	gCurRow = 0; gCurCol = 0;
}

//-----------------------------------------------------------------
// LCM 初始化
//-----------------------------------------------------------------
char LCD_Initialise()
{
	RESET = 0;
	RESET = 1;
	LCD_Write_Command_P2(LCD_TXT_STP,0x00,0x00);		//文本显示区首地址
	LCD_Write_Command_P2(LCD_TXT_WID,LCD_WIDTH,0x00);	//文本显示区宽度
	LCD_Write_Command_P2(LCD_GRH_STP,0x00,0x00);		//图形显示区首地址
	LCD_Write_Command_P2(LCD_GRH_WID,LCD_WIDTH,0x00);	//图形显示区宽度
	LCD_Write_Command_P1(LCD_CGR_POS, CGRAMSTART >> 11);
	LCD_Write_Command(LCD_CUR_SHP | 0x01);				//光标形状
	LCD_Write_Command(LCD_MOD_OR);						//显示方式设置
	LCD_Write_Command(LCD_DIS_SW  | 0x08);
	grhome = GRSTART;
	txthome = TXTSTART;
	return 0;
}


//-----------------------------------------------------------------
// ASCII及汉字显示
//-----------------------------------------------------------------
INT8U Display_Str_at_xy(INT8U x,INT8U y,char *fmt)
{
	char c1,c2,cData;  INT8U i = 0,j,uLen = strlen(fmt);
	while(i < uLen)
	{   c1 = fmt[i]; c2 = fmt[i+1];	//取得两字节汉字内码
		Set_LCD_POS(y,x/8);
		if(c1 >= 0) // ASCII
		{   if(c1 < 0x20)
			{   switch(c1)
				{   case CR:
					case LF:	  //回车或换行
						i++;x = 0; if(y < 112) y += HZ_CHR_HEIGHT;
						continue;
					case BS:	  //退格
						i++; if(y > ASC_CHR_WIDTH) y -= ASC_CHR_WIDTH;
						cData = 0x00;
						break;
				}
			} 
			for(j = 0; j < ASC_CHR_HEIGHT; j++)
			{   if(c1 >= 0x1F)
				{ 	cData = ASC_MSK[ (c1 - 0x1F) * ASC_CHR_HEIGHT + j];
					Set_LCD_POS( y + j , x / 8);
					if( (x % 8) == 0)
					{	LCD_Write_Command(LCD_AUT_WR); //写数据
						LCD_Write_Data(cData);	
						LCD_Write_Command(LCD_AUT_OVR);
					}
					else OutToLCD(cData,x,y+j);
				}
				Set_LCD_POS(y + j, x / 8);
			}
			if(c1 != BS) x += ASC_CHR_WIDTH;  //非退格
		}
		i++;
	}
	return uLen;
}

//-----------------------------------------------------------------
// 输出起点x不是8的倍数时,原字节分成两部分输出到LCD
//-----------------------------------------------------------------
void OutToLCD(INT8U Dat,INT8U x,INT8U y) 
{
	INT8U dat1,dat2,a,b; 
	b = x % 8; a = 8 - b;
	Set_LCD_POS(y,x / 8);
	LCD_Write_Command(LCD_AUT_RD); 
	dat1 = LCD_Read_Data();
	dat2 = LCD_Read_Data();
	//将读取的前后两字节分别与待显示字节的前后部分组合
	dat1 = (dat1 & (0xFF<<a)) | (Dat>>b);
	dat2 = (dat2 & (0xFF>>b)) | (Dat<<a);
	LCD_Write_Command(LCD_AUT_OVR);
	Set_LCD_POS(y,x / 8);	 
	//输出组合后的两字节
	LCD_Write_Command(LCD_AUT_WR); 
	LCD_Write_Data(dat1);	
	LCD_Write_Data(dat2);
	LCD_Write_Command(LCD_AUT_OVR);
}

//-----------------------------------------------------------------
// 绘点函数
// 参数:点的坐标,模式1/0分别为显示与清除点
//-----------------------------------------------------------------
void Pixel(INT8U x,INT8U y, bit Mode)
{
	INT8U start_addr, dat;
	start_addr = 7 - ( x % 8);
	dat = LCD_BIT_OP | start_addr;			//生成位操作命令绘点数据
	if (Mode) dat |= 0x08;
	Set_LCD_POS(y, x / 8);
	LCD_Write_Command(LCD_BIT_OP | dat);	//写数据
}

//-----------------------------------------------------------------
// 两数交换
//-----------------------------------------------------------------
void Exchange(INT8U *a, INT8U *b)
{
	INT8U t;  t = *a; *a = *b; *b = t;
}

//-----------------------------------------------------------------
// 绘制直线函数
// 参数:起点与终点坐标,模式为显示(1)或清除(0),点阵不超过255*255)
//-----------------------------------------------------------------
void Line(INT8U x1,INT8U y1, INT8U x2,INT8U y2, bit Mode)
{
	INT8U x,y;		//绘点坐标
	float k,b;		//直线斜率与偏移 
	if( abs(y1 - y2) <= abs( x1 - x2) ) 
	{	k = (float)(y2 - y1) / (float)(x2 - x1) ; 
		b = y1 - k * x1;
		if( x1 > x2 ) Exchange(&x1, &x2);
		for(x = x1;x <= x2; x++)
		{	y = (INT8U)(k * x + b);
			Pixel(x, y, Mode);
		}
	}
	else 
	{	k = (float)(x2 - x1) / (float)(y2 - y1) ;
		b = x1 - k * y1;
		if( y1 > y2 ) Exchange(&y1, &y2);
		for(y = y1;y <= y2; y++)
		{   x = (INT8U)(k * y + b);
			Pixel( x , y,Mode );
		}
	}
}