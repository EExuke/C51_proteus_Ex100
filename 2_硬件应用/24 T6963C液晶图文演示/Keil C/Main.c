//-----------------------------------------------------------------
//  名称:T6963C LCD图形滚动演示
//-----------------------------------------------------------------
//  说明:本例综合演示了T6963C液晶的图文显示功能: 包括图像显示,滚动,
//		反白.合上"图文"开关时显示一幅条形统计图.
//
//-----------------------------------------------------------------
#include <T6963C.h>
#include <stdio.h>
#define INT8U  unsigned char
#define INT16U unsigned int
extern void cls();								//清屏
extern INT8U LCD_Initialise();					//LCD初始化
extern INT8U LCD_Write_Command(INT8U cmd);		//写无参数的命令
extern INT8U LCD_Write_Command_P2(INT8U cmd,INT8U para1,INT8U para2); //写双参数命令
extern INT8U LCD_Write_Data(INT8U dat);			//写数据
extern void Set_LCD_POS(INT8U row, INT8U col);	//设置当前地址
extern void Line(INT8U x1,INT8U y1, INT8U x2,INT8U y2, bit Mode);//绘制线条
extern INT8U Display_Str_at_xy(INT8U x,INT8U y,char *fmt);	//显示字符串
extern INT8U code LCD_WIDTH;
extern INT8U code LCD_HEIGHT;
//按键定义
sbit S1 = P1^0 ;	//正常显示
sbit S2 = P1^1 ;	//反白
sbit S3 = P1^2 ;	//滚动
sbit S4 = P1^3 ;	//图文
//显示在LCD上的图像
INT8U code ImageX[] = { 
0x00,0x00,0x00,0x00,0x00,0x00,0x00,0x00,0x00,0x00,0x00,0x00,0x00,0x00,0x00,0x00,
0x00,0x00,0x00,0x00,0x00,0x00,0x00,0x00,0x00,0x00,0x00,0x00,0x00,0x00,0x00,0x00,
0x00,0x00,0x00,0x00,0x00,0x00,0x00,0x00,0x00,0x00,0x00,0x00,0x00,0x00,0x00,0x00,
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0x00,0x00,0x00,0x00,0x00,0x00,0x00,0x00,0x00,0x00,0x00,0x00,0x00,0x00,0x00,0x00
};
INT8U Current_Operation = 0;						//当前操作序号
INT8U Statistics_Data[] = {20,70,80,40,90,65,30};	//待显示的统计数据
//-----------------------------------------------------------------
// 绘制条形图
//-----------------------------------------------------------------
void Draw_Bar_Graph(INT8U d[])
{
	INT8U i,h;
	Line(4,2,4,100,1);			//纵轴
	Line(4,100,158,100,1);		//横轴
	Line(4,2,1,10,1);			//横轴箭头
	Line(4,2,7,10,1);	
	Line(158,100,152,98,1);		//纵轴箭头
	Line(158,100,152,102,1);
	for (i = 0; i < 7; i++)		//输出条形图
	{	h = 100 - d[i];
		Line(10 + i * 20, h,	10 + i * 20,	 100, 1);
		Line(10 + i * 20, h,	10 + i * 20 + 15,  h, 1);
		Line(10 + i * 20 + 15,h,10 + i * 20 + 15,100, 1);
	}
}

//-----------------------------------------------------------------
// 主程序
//-----------------------------------------------------------------
void main()
{
	INT8U i,j,m,c = 0;  INT16U k,x;
	LCD_Initialise();			//初始化LCD
	Set_LCD_POS(0,0); cls();	//从LCD左上角开始清屏
	while(1)
	{	if (S1 == 0) Current_Operation = 1;//正常
		if (S2 == 0) Current_Operation = 2;//反白
		if (S3 == 0) Current_Operation = 3;//滚动
		if (S4 == 0) Current_Operation = 4;//图文
		//如果操作类型未改变则仅执行延时.
		if ( c == Current_Operation) goto delayx;
		c = Current_Operation; 
		switch (Current_Operation)
		{	case 1: //正常或反白显示
			case 2: LCD_Write_Command_P2( LCD_GRH_STP,0x00,0x00);




			case 3: //滚动显示,每次向下移动一行GFXHOME地址(20字节)





			case 4: //图文显示



		}
		delayx:for (x = 0; x < 20000; x++); 	//延时
	}
}