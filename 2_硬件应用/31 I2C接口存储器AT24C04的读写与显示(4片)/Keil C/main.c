//-----------------------------------------------------------------
//	名称: I2C接口存储器AT24C04读写与显示(4片)
//-----------------------------------------------------------------
//	说明: 按下K1-K4按键时,前两个分别向第1,2片AT24C04中写入400个随机字节
//		  后2个按键分别写第3,4片AT24C04,先写入200个0x01,再写入200个0x02
//		  写入后接着读取并显示.(400个字节的地址范围: 0x0000~0x018F)
//
//-----------------------------------------------------------------
#define INT8U  unsigned char
#define INT16U unsigned int
#include <reg51.h>
#include <intrins.h>
#include <stdio.h>
#include <stdlib.h>
sbit K1 = P3^3;		//四个操作按键定义
sbit K2 = P3^4;
sbit K3 = P3^5;
sbit K4 = P3^6;
INT16U r = 0;		//满20个字节换行控制变量
//AT24C04相关函数
extern void Random_Write(INT8U Dev_Addr,INT16U mem_addr,INT8U dat);
extern INT8U Random_Read(INT8U Dev_Addr,INT16U mem_addr);
extern void Sequential_Read(INT8U Dev_Addr,INT16U mem_addr,INT16U N);
//-----------------------------------------------------------------
// 延时函数
//-----------------------------------------------------------------
void delay_ms(INT16U x) {INT8U t; while(x--) for(t = 0; t<120; t++);}
//-----------------------------------------------------------------
// 向串口发送1字节
//-----------------------------------------------------------------
void PutChar(INT8U c) {	SBUF = c; while( TI == 0 ); TI = 0;}
//-----------------------------------------------------------------
// 向串口发送字符串
//-----------------------------------------------------------------
void PutStr(INT8U *s) { while(*s) PutChar(*s++); }
//-----------------------------------------------------------------
// sprintf对%2X格式支持不稳定,编译时有时可以输出正确结果,有时则不正常
// sprintf(s,"%02X ",(INT8U)Random_Read(0xA0,i)); PutStr(s);
// 故改用下面的函数实现十六进制形式显示所读取的字节
//-----------------------------------------------------------------
void Show_HEX(INT8U dat)
{

}

//-----------------------------------------------------------------
// 主程序
//-----------------------------------------------------------------
void main()
{
	INT16U i; char s[] = "NO.X\r\n";
	INT8U n = 0, ChipNo = 0;
	//串口配置
	SCON = 0x40;	TMOD = 0x20;	PCON = 0;
	TH1 = 0xFD;		TL0 = 0xFD;
	TI = 0;			TR1 = 1;
	srand(30);		//随机种子
	PutStr("\r\n>>> Press K1~K4, Write/Read No.1~4 AT24C04...\r\n ");
	while(1)
	{	if ((P3 & 0xF0) != 0xF0)		//P3端口高4位按键状态检测
		{



		} else { delay_ms(10); continue; }
		PutStr("\r\n\r\n>>> Write IIC, Waiting.........\r\n\r\n ");
		//提示当前读取的AT24C04芯片号1~4(由0~3加1得到)
		s[3] = ChipNo + '1'; PutStr(s);	
		switch (ChipNo)
		{	case 0: case 1:	 //K1,K2分别向第1,2片写入400个随机字节



			case 2: case 3:	 //K3,K4分别写第3,4片,写入200个0x01，0x02



		}
		PutStr("\r\n\r\n>>> Reading From IIC...........\r\n\r\n"); 
		r = 0;							//满20个字节换行显示控制变量归0
		//从指定的AT24C04中读取400字节并发送串口显示,下面两种读取方法中,
		//随机寻址单字节读取共400字节将明显慢于顺序连续读取400字节









	}
}