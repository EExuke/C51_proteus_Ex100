//-----------------------------------------------------------------
// T6963C LCD显示控制程序
//-----------------------------------------------------------------
#include <stdarg.h>
#include <stdio.h>
#include <math.h>
#include <intrins.h>
#include <absacc.h>
#include <string.h>
#include <T6963C.h>
//ASCII字模8*8
#define ASC_CHR_WIDTH	8
#define ASC_CHR_HEIGHT	12
//汉字字模12*12
#define HZ_CHR_HEIGHT	12
#define HZ_CHR_WIDTH	12
INT8U code LCD_WIDTH  = 20;   //宽160像素(160/8 = 20个字节)
INT8U code LCD_HEIGHT = 128;  //高128像素
//ASC字符点阵库
INT8U code ASC_MSK[96 * 12] = {
0x00,0x00,0x00,0x00,0x00,0x00,0x00,0xff,0xff,0xff,0xff,0xff, // < 0x20时
0x00,0x00,0x00,0x00,0x00,0x00,0x00,0x00,0x00,0x00,0x00,0x00,// ' '
0x00,0x30,0x78,0x78,0x78,0x30,0x30,0x00,0x30,0x30,0x00,0x00,// '!'
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0x00,0x73,0xda,0xce,0x00,0x00,0x00,0x00,0x00,0x00,0x00,0x00,// '~'
};
struct typFNT_GB16 // 汉字字模显示数据结构
{
  char Index[2];  char Msk[24];
};
//本例汉字点阵库,12*12点阵,宋体小五号,用Zimo软件取点阵
struct typFNT_GB16 code GB_16[] = { 
"液",0x81,0x00,0x5F,0xE0,0x25,0x00,0x85,0xC0,0xAA,0x40,0x4E,0xC0,
	 0x5A,0x40,0x49,0x80,0xC8,0x80,0x49,0x40,0x4E,0x20,0x00,0x00,
"晶",0x1F,0x80,0x10,0x80,0x1F,0x80,0x10,0x80,0x1F,0x80,0x00,0x00,
	 0x7B,0xE0,0x4A,0x20,0x7B,0xE0,0x4A,0x20,0x7B,0xE0,0x00,0x00,
"屏",0x7F,0xC0,0x40,0x40,0x7F,0xC0,0x50,0x80,0x49,0x00,0x5F,0xC0,
	 0x49,0x00,0x7F,0xE0,0x49,0x00,0x91,0x00,0xA1,0x00,0x00,0x00,
"转",0x21,0x00,0xF9,0x00,0x47,0xE0,0x61,0x00,0xA7,0xE0,0xFA,0x00,
	 0x23,0xC0,0x38,0x40,0xE0,0x80,0x23,0x00,0x20,0x80,0x00,0x00,
"换",0x22,0x00,0x27,0x80,0xF8,0x80,0x2F,0xC0,0x29,0x40,0x39,0x40,
	 0xE9,0x40,0x3F,0xE0,0x22,0x80,0x24,0x40,0xF8,0x20,0x00,0x00,
"显",0x3F,0x80,0x20,0x80,0x3F,0x80,0x20,0x80,0x3F,0x80,0x00,0x00,
	 0x4A,0x40,0x2A,0x40,0x2A,0x80,0x0B,0x00,0xFF,0xE0,0x00,0x00,
"示",0x00,0x80,0x7F,0xC0,0x00,0x00,0x00,0x00,0xFF,0xE0,0x04,0x00,
	 0x14,0x80,0x24,0x40,0x44,0x20,0x84,0x20,0x1C,0x00,0x00,0x00,
"两",0xFF,0xE0,0x12,0x00,0x12,0x00,0x7F,0xC0,0x52,0x40,0x52,0x40,
	 0x5B,0x40,0x64,0xC0,0x48,0x40,0x40,0x40,0x41,0xC0,0x00,0x00,
"路",0xF2,0x00,0x93,0xC0,0x94,0x40,0xFA,0x80,0xA1,0x00,0x22,0x80,
	 0xB7,0xE0,0xAA,0x40,0xA2,0x40,0xFA,0x40,0x83,0xC0,0x00,0x00,
"结",0x21,0x00,0x21,0x00,0x4F,0xE0,0x91,0x00,0xE1,0x00,0x2F,0xE0,
	 0x50,0x00,0xE7,0xC0,0x04,0x40,0x34,0x40,0xC7,0xC0,0x00,0x00,
"果",0x3F,0xC0,0x24,0x40,0x3F,0xC0,0x24,0x40,0x3F,0xC0,0x04,0x00,
	 0xFF,0xE0,0x0E,0x00,0x15,0x00,0x24,0x80,0xC4,0x60,0x00,0x00,
"曲",0x09,0x00,0x09,0x00,0x7F,0xE0,0x49,0x20,0x49,0x20,0x49,0x20,
	 0x7F,0xE0,0x49,0x20,0x49,0x20,0x49,0x20,0x7F,0xE0,0x00,0x00,
"线",0x22,0x80,0x22,0x40,0x52,0x60,0x97,0x80,0xE2,0x60,0x4F,0x80,
	 0xB2,0x40,0xC2,0x80,0x31,0x20,0xC6,0xA0,0x18,0x60,0x00,0x00
};
INT8U gCurRow,gCurCol;		//图形当前行、列存储，行高16点，列宽8点
INT8U tCurRow,tCurCol;		//文本当前行、列存储，行高8点 ，列宽8点
INT8U ShowModeSW;			//当前显示模式
INT16U  txthome,grhome;
//-----------------------------------------------------------------
// LCD控制相关函数
//-----------------------------------------------------------------
INT8U Status_BIT_01();	// 状态位STA1,STA0判断（读写指令和读写数据）
INT8U Status_BIT_3();	// 状态位ST3判断（数据自动写状态）
INT8U GetRow();			//返回当前行
INT8U GetCol();			//返回当前列
INT8U LCD_Write_Command(INT8U cmd);					//写无参指令
INT8U LCD_Write_Command_P1(INT8U cmd,INT8U para1);	//写单参数指令
INT8U LCD_Write_Command_P2(INT8U cmd,INT8U para1,INT8U para2);//写双参数指令
INT8U LCD_Write_Data(INT8U dat);					//写数据
INT8U LCD_Read_Data(); 								//读数据
void LCD_Initialise();								//LCD初始化
void Set_LCD_POS(INT8U row, INT8U col);				//设置显示地址
void OutToLCD(INT8U Dat,INT8U x,INT8U y);			//显示辅助函数
//-----------------------------------------------------------------
// 状态位STA1,STA0判断(读写指令和读写数据)
//-----------------------------------------------------------------
INT8U Status_BIT_01() 
{


}

//-----------------------------------------------------------------
// 状态位ST3判断(数据自动写状态)
//-----------------------------------------------------------------
INT8U Status_BIT_3() 
{


}

//-----------------------------------------------------------------
// 写双参数指令
//-----------------------------------------------------------------
INT8U LCD_Write_Command_P2(INT8U cmd,INT8U para1,INT8U para2) 
{


}

//-----------------------------------------------------------------
// 写单参数指令
//-----------------------------------------------------------------
INT8U LCD_Write_Command_P1(INT8U cmd,INT8U para1) 
{


}

//-----------------------------------------------------------------
// 写无参指令
//-----------------------------------------------------------------
INT8U LCD_Write_Command(INT8U cmd) 
{


}

//-----------------------------------------------------------------
// 写数据
//-----------------------------------------------------------------
INT8U LCD_Write_Data(INT8U dat) 
{


}

//-----------------------------------------------------------------
// 读LCD数据
//-----------------------------------------------------------------
INT8U LCD_Read_Data() 
{


}

//-----------------------------------------------------------------
// 设置当前地址
//-----------------------------------------------------------------
void Set_LCD_POS(INT8U row, INT8U col)
{
	INT16U Pos = row * LCD_WIDTH + col;
	LCD_Write_Command_P2(LC_ADD_POS,Pos & 0xFF, Pos >> 8);
	gCurRow = row;
	gCurCol = col;
}

//-----------------------------------------------------------------
// LCM 初始化
//-----------------------------------------------------------------
void LCD_Initialise()
{
	RESET = 0;
	RESET = 1;
	LCD_Write_Command_P2(LC_TXT_STP,0x00,0x00);		//文本显示区首地址
	LCD_Write_Command_P2(LC_TXT_WID,LCD_WIDTH,0x00);//文本显示区宽度
	LCD_Write_Command_P2(LC_GRH_STP,0x00,0x00);		//图形显示区首地址
	LCD_Write_Command_P2(LC_GRH_WID,LCD_WIDTH,0x00);//图形显示区宽度
	LCD_Write_Command_P1(LC_CGR_POS, CGRAMSTART >> 11);
	LCD_Write_Command(LC_CUR_SHP | 0x01);			//光标形状
	LCD_Write_Command(LC_MOD_OR);					//显示方式设置
	LCD_Write_Command(LC_DIS_SW  | 0x08);	
	grhome = GRSTART;
	txthome = TXTSTART;
}

//-----------------------------------------------------------------
// ASCII及汉字显示
//-----------------------------------------------------------------
void Display_Str_at_xy(INT8U x,INT8U y,char *Buffer)
{
	char c1,c2,cData;
	INT8U i = 0,j,k,uLen;
	uLen = strlen(Buffer);
	while(i < uLen)
	{ 	c1 = Buffer[i];	c2 = Buffer[i+1];
		Set_LCD_POS(y,x / 8);
		//ASCII字符显示
		if(c1 >= 0) 
		{   if(c1 < 0x20)
			{	switch(c1)
				{	case CR: case LF: 	//回车或换行
						i++; x = 0;
						if(y < 112) y += HZ_CHR_HEIGHT;	continue;
		 			case BS:			//退格
						i++; if(y > ASC_CHR_WIDTH) y -= ASC_CHR_WIDTH;
		 				cData = 0x00;
						break;
				}
			} 
			for(j = 0; j < ASC_CHR_HEIGHT; j++)
			{	if(c1 >= 0x1F)
		 		{	cData = ASC_MSK[ (c1 - 0x1F) * ASC_CHR_HEIGHT + j];
					Set_LCD_POS( y + j , x / 8);
					if( (x % 8) == 0)
					{	LCD_Write_Command(LC_AUT_WR);	//写数据
						LCD_Write_Data(cData);	
						LCD_Write_Command(LC_AUT_OVR);
					}
					else OutToLCD(cData,x,y+j);
				}
				Set_LCD_POS(y + j, x / 8);
			}
		 	if(c1 != BS) x += ASC_CHR_WIDTH; 			//非退格
		}
		
		//中文字符显示
		else  
		{ 	for(j = 0;j < sizeof(GB_16)/sizeof(GB_16[0]);j++)
			  if(c1 == GB_16[j].Index[0] && c2 == GB_16[j].Index[1]) break;
			for(k = 0;k < HZ_CHR_HEIGHT; k++)
			{ 	Set_LCD_POS(y + k, x / 8);
				if(j < sizeof(GB_16)/sizeof(GB_16[0]))
				{	c1 = GB_16[j].Msk[k*2];
					c2 = GB_16[j].Msk[k*2+1];
				}
				else c1 = c2 = 0;
				if((x % 8) == 0)
				{ 	LCD_Write_Command(LC_AUT_WR); LCD_Write_Data(c1);
					LCD_Write_Command(LC_AUT_OVR);
				}
				else OutToLCD(c1,x,y + k);
				
				if(((x + 2 + HZ_CHR_WIDTH / 2) % 8) == 0)
				{	LCD_Write_Command(LC_AUT_WR); LCD_Write_Data(c2);
					LCD_Write_Command(LC_AUT_OVR);
				}
				else OutToLCD(c2,x + 2 + HZ_CHR_WIDTH / 2,y + k);
			}
			x += HZ_CHR_WIDTH;  i++;
		} 
		i++;
	}
}

//-----------------------------------------------------------------
// 输出起点x不是8的倍数时,原字节分成两部分输出到LCD
//-----------------------------------------------------------------
void OutToLCD(INT8U Dat,INT8U x,INT8U y) 
{
    INT8U dat1,dat2,a,b;
    b = x % 8; a = 8 - b; 
    Set_LCD_POS(y,x / 8);
    LCD_Write_Command(LC_AUT_RD); 
    dat1 = LCD_Read_Data();  dat2 = LCD_Read_Data();
    //将读取的前后两字节分别与待显示字节的前后部分组合
    dat1 = (dat1 & (0xFF<<a)) | (Dat>>b);
    dat2 = (dat2 & (0xFF>>b)) | (Dat<<a);
    LCD_Write_Command(LC_AUT_OVR);
    Set_LCD_POS(y,x / 8);
    //输出组合后的两字节
    LCD_Write_Command(LC_AUT_WR);
    LCD_Write_Data(dat1);
    LCD_Write_Data(dat2);
    LCD_Write_Command(LC_AUT_OVR);
}

//-----------------------------------------------------------------
// 绘点函数
// 参数:点的坐标,模式1/0分别为显示与清除点
//-----------------------------------------------------------------
void Pixel(INT8U x,INT8U y, bit Mode)
{
    INT8U start_addr, dat;
    start_addr = 7 - ( x % 8);
    dat = LC_BIT_OP | start_addr;		//生成位操作命令绘点数据
	if (Mode) dat |= 0x08;
	Set_LCD_POS(y, x / 8);
	LCD_Write_Command(LC_BIT_OP | dat);	// 写数据
}

//-----------------------------------------------------------------
// 两数交换
//-----------------------------------------------------------------
void Exchange(INT8U *a, INT8U *b)
{
   INT8U t;	t = *a; *a = *b; *b = t;
}

//-----------------------------------------------------------------
// 绘制直线函数
// 参数:起点与终点坐标,模式为显示(1)或清除(0),点阵不超过255*255
//-----------------------------------------------------------------
void Line(INT8U x1,INT8U y1, INT8U x2,INT8U y2, bit Mode)
{
    INT8U x,y;							//绘点坐标
    float k,b;							//直线斜率与偏移
    if( abs(y1 - y2) <= abs( x1 - x2) ) 
    {   k = (float)(y2 - y1) / (float)(x2 - x1) ; 
        b = y1 - k * x1;
        if( x1 > x2 ) Exchange(&x1, &x2);
        for(x = x1;x <= x2; x++)
        {   y = (INT8U)(k * x + b); Pixel(x, y, Mode);
        }
    }
    else 
    {   k = (float)(x2 - x1) / (float)(y2 - y1) ;
        b = x1 - k * y1;
        if( y1 > y2 ) Exchange(&y1, &y2); 
        for(y = y1;y <= y2; y++)
        {   x = (INT8U)(k * y + b); Pixel( x , y,Mode );
        }
    }
}