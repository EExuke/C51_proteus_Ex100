//-----------------------------------------------------------------
//  名称:  基于MODBUS总线的数据采集与开关控制系统设计仿真(主机程序)
//-----------------------------------------------------------------
//  说明: 本例运行时,主机向各从机发送要求返回A/D转换值的命令码或
//		  开/关状态主机完整接收到相关信息后,在液晶上刷新显示.
//
//-----------------------------------------------------------------
#define INT8U  unsigned char
#define INT16U unsigned int
#define INT32U unsigned long
#include <reg51.h>
#include <intrins.h>
#include <stdio.h>
#define  ADC_REQ	65				//返回A/D值命令
#define  RELAY_ON	66				//继电器闭合命令
#define  RELAY_OFF	67				//继电器断开命令
//9600波特率每字符时间为: 1/9600*(1+8+1) ≈  1041.66us
//帧  间: 3.5个字符时间为: 1041.66 * (3.5 + 1) ≈ 4687.5us
//字节间: 1.5个字符时间为: 1041.66 * (1.5 + 1) ≈ 2604.2us
#define FRAME_SPAN  4688			//相临帧之间的间隔时间
#define BYTE_SPAN	2604			//帧内字节之间的间隔时间
code char* Prompts[17] = 
{	" RS-485  MODBUS ",
	"****************",
	"  TEST PROGRAM  ",
	"****************"
};
volatile INT8U recv_Data[6];		//串口接收数据缓冲区(6字节)
volatile INT8U recv_idx = 0;		//串口接收数据缓冲区索引
volatile INT8U sl_Addr,CMD_CODE;	//485从机地址,命令码字节
INT8U  LCD_Buffer[21];				//LCD显示缓冲
bit	F_T0, T_BYTE, T_FRAME, Recv_OK;	//相关标识位
sbit  LED_Recv = P0^6;				//主机接收指示灯
sbit  LED_Send = P0^7;				//主机发送指示灯
sbit  RDE_485 =	 P3^7;				//RS485通信控制端
bit   ST_K1 = 0,ST_K2 = 0;			//K1,K2按键初始状态
extern void Initialize_LCD();		//LCD初始化
extern void LCD_ShowString(INT8U r, INT8U c,char *str);//LCD显示
INT16U uCRC16;						//CRC16校验码
void CRC_16(INT8U d);				//CRC16校验函数
//-----------------------------------------------------------------
// 延时函数
//-----------------------------------------------------------------
void delay_ms(INT16U x) {INT8U t; while(x--) for(t = 0; t<120; t++);}
//-----------------------------------------------------------------
// 宏定义: 发送一字节并等待发送结束
//-----------------------------------------------------------------
#define Send_Byte(x)				\
{									\
	LED_Send = 1; RDE_485 = 1;		\
	SBUF = x; while (TI == 0);		\
	TI = 0; LED_Send = 0;			\
}

//-----------------------------------------------------------------
// 宏定义: 设置TIMER0的定时初值并设相关标志位(振荡器频率11.0592MHz)
//-----------------------------------------------------------------
#define Set_TIMER0(x)							\
{												\
	TH0 = (INT16U)(-11.0592/12.0 * x) >> 8;		\
	TL0 = (INT16U)(-11.0592/12.0 * x) & 0xFF;	\
	TF0 = T_BYTE = T_FRAME = 0;					\
	F_T0 =(x == FRAME_SPAN) ?1:0;				\
	if (F_T0) recv_idx = 0;						\
}

//-----------------------------------------------------------------
// 主程序
//-----------------------------------------------------------------
void main()
{


}

//-----------------------------------------------------------------
// 串口接收中断
//-----------------------------------------------------------------
void SerialPort_INT() interrupt 4
{


}

//-----------------------------------------------------------------
// TIMER0定时器溢出中断
//-----------------------------------------------------------------
void TIMER0_OVF_INT() interrupt 1 
{


}

//-----------------------------------------------------------------
// INT0中断(K1按键)
//-----------------------------------------------------------------
void EX_INT0() interrupt 0
{


}

//-----------------------------------------------------------------
// INT1中断(K2按键)
//-----------------------------------------------------------------
void EX_INT1() interrupt 2 
{


}

//-----------------------------------------------------------------
// CRC_16校验函数 (基于该函数可得出512字节的校验码表,改用查表法进行校验)
// 多项式: X ^ 16 + X ^ 15 + X ^ 2 + 1, 去高位逆序表示:0xA001
//-----------------------------------------------------------------
//void CRC_16(INT8U d)
//{	INT8U i;
//	for ( i = 0; i < 8; i++)
//	{	//uCRC16待右移出的低位与参与校验字节d的第i位相异
//		if ((uCRC16 ^ (d >> i)) & 0x01) 
//		{	//则uCRC16右移1位,然后与生成多项式编码0xA001异或
//			uCRC16 >>= 1 ; uCRC16 ^= 0xA001; 
//		}	else uCRC16 >>= 1; //否则仅右移1位(这里省略了与0x0000异或)
//	}
//}
//-----------------------------------------------------------------
// CRC_16校验码表(由上面的比特型CRC16校验函数生成，共256项，512字节)
//-----------------------------------------------------------------
code INT16U CRC_T16[] = 
{	0x0000,0xC0C1,0xC181,0x0140,0xC301,0x03C0,0x0280,0xC241,0xC601,0x06C0,
	0x0780,0xC741,0x0500,0xC5C1,0xC481,0x0440,0xCC01,0x0CC0,0x0D80,0xCD41,
	0x0F00,0xCFC1,0xCE81,0x0E40,0x0A00,0xCAC1,0xCB81,0x0B40,0xC901,0x09C0,
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	0x4380,0x8341,0x4100,0x81C1,0x8081,0x4040
};
//-----------------------------------------------------------------
// CRC_16校验函数(查表法)
//-----------------------------------------------------------------
void CRC_16(INT8U d) {             }