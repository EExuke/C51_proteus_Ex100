//-----------------------------------------------------------------
//  名称: MODBUS总线通信仿真(从机程序)--Modbus从机-开关控制
//-----------------------------------------------------------------
//  说明: 从机接收到主机控制命令后切换继电器开关,并回发当前开关状态.
//
//-----------------------------------------------------------------
#define INT8U  unsigned char
#define INT16U unsigned int
#define INT32U unsigned long
#include <reg51.h>
#include <intrins.h>
#include <stdio.h>
#define  RELAY_ON	66				//继电器闭合命令
#define  RELAY_OFF	67				//继电器断开命令
//9600波特率每字符时间为: 1/9600*(1+8+1) ≈  1041.66us
//帧  间: 3.5个字符时间为: 1041.66 * (3.5 + 1) ≈ 4687.5us
//字节间: 1.5个字符时间为: 1041.66 * (1.5 + 1) ≈ 2604.2us
#define FRAME_SPAN  4688			//相临帧之间的间隔时间
#define BYTE_SPAN	2604			//帧内字节之间的间隔时间
volatile INT8U recv_Data[6];		//串口接收数据缓冲区(6字节)
volatile INT8U recv_idx = 0;		//串口接收数据缓冲区索引
volatile INT8U sl_Addr;				//485从机地址
INT16U uCRC16;						//CRC校验结果	
volatile bit  Recv_OK;				//相关标识位
volatile bit F_T0, T_BYTE, T_FRAME;	//相关标识位
sbit  LED_Ptr = P1^4;				//LED指示灯
sbit  RDE_485 =	P1^7;				//RS485通信控制端
sbit  SW = P3^2;					//开关控制线
//-----------------------------------------------------------------
// 宏定义: 发送一字节并等待发送结束
//-----------------------------------------------------------------
#define Send_Byte(x)				\
{									\
	LED_Ptr = ~LED_Ptr;				\
	RDE_485 = 1; SBUF = x;			\
	while (TI == 0); TI = 0;		\
	LED_Ptr = 1;					\
}

//-----------------------------------------------------------------
// 宏定义: 设置TIMER0的定时初值并设相关标志位(振荡器频率11.0592MHz)
//-----------------------------------------------------------------
#define Set_TIMER0(x)							\
{												\
	TH0 = (INT16U)(-11.0592/12.0 * x) >> 8;		\
	TL0 = (INT16U)(-11.0592/12.0 * x) & 0xFF;	\
	TF0 = T_BYTE = T_FRAME = 0;					\
	F_T0 =(x == FRAME_SPAN) ?1:0;				\
	if (F_T0) recv_idx = 0;						\
}

//-----------------------------------------------------------------
// 延时函数
//-----------------------------------------------------------------
void delay_ms(INT16U x) {INT8U t; while(x--) for(t = 0; t<120; t++);}
//-----------------------------------------------------------------
// CRC_16校验函数 (基于该函数可得出512字节的校验码表,改用查表法进行校验)
// 多项式: X ^ 16 + X ^ 15 + X ^ 2 + 1, 去高位逆序表示:0xA001
//-----------------------------------------------------------------
void CRC_16(INT8U d)
{

}
//-----------------------------------------------------------------
// 主程序
//-----------------------------------------------------------------
void main()
{


}

//-----------------------------------------------------------------
// 串口接收中断
//-----------------------------------------------------------------
void SerialPort_INT() interrupt 4
{


}

//-----------------------------------------------------------------
// TIMER0定时器溢出中断
//-----------------------------------------------------------------
void TIMER0_OVF_INT() interrupt 1 
{


}